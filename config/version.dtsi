#define VERSION_MACRO
macro_ver: macro_ver {
compatible = "zmk,behavior-macro";
label = "macro_ver";
#binding-cells = <0>;
bindings = <&kp N2>, <&kp N0>, <&kp N2>, <&kp N4>, <&kp N0>, <&kp N5>, <&kp N0>, <&kp N6>, <&kp MINUS>, <&kp V>, <&kp N3>, <&kp DOT>, <&kp N0>, <&kp MINUS>, <&kp N9>, <&kp C>, <&kp N7>, <&kp E>, <&kp N7>, <&kp A>, <&kp N6>, <&kp RET>;
};
